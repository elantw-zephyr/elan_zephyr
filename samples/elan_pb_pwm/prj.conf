## CMakeLists.txt
```
# SPDX-License-Identifier: Apache-2.0
#
# EM32F967 All-Port-B PWM Sample — runs PWMA..PWMF simultaneously on PB10..PB15.

cmake_minimum_required(VERSION 3.20.0)

list(APPEND ZEPHYR_EXTRA_MODULES ${CMAKE_CURRENT_LIST_DIR}/../..)

message(STATUS "Include compat_overlays.cmake!")
include(${ZEPHYR_EXTRA_MODULES}/cmake/compat_overlays.cmake)

find_package(Zephyr REQUIRED HINTS $ENV{ZEPHYR_BASE})
project(elan_pb_pwm_sample)

target_sources(app PRIVATE src/main.c)
```

## prj.conf
```kconfig
# EM32F967 All-Port-B PWM Sample

# ---- PWM driver ----
CONFIG_PWM=y
CONFIG_PWM_LOG_LEVEL_DBG=y

# ---- Pinctrl ----
CONFIG_PINCTRL=y
CONFIG_PINCTRL_EM32=y
CONFIG_PINCTRL_LOG_LEVEL_DBG=y

# ---- Console / logging ----
CONFIG_SERIAL=y
CONFIG_UART_CONSOLE=y
CONFIG_UART_EM32=y
CONFIG_CONSOLE=y
CONFIG_PRINTK=y

CONFIG_LOG=y
CONFIG_LOG_DEFAULT_LEVEL=3
CONFIG_LOG_BUFFER_SIZE=8192

# ---- Kernel ----
CONFIG_MAIN_STACK_SIZE=2048
CONFIG_BUILD_OUTPUT_INFO_HEADER=y
```

## 32f967_dv.overlay
```dts
/*
 * SPDX-FileCopyrightText: 2026 ELAN Microelectronics Corp.
 * SPDX-License-Identifier: Apache-2.0
 *
 * Overlay for samples/elan_pb_pwm — route all six EM32F967 PWM channels
 * (PWMA..PWMF) simultaneously to the Port-B "alternative" pin assignment
 * (IP_Share[18] = PWM_S = 1):
 *
 *   PWMA: PB11 (N)     PWMD: PB10 (P)
 *   PWMB: PB13 (N)     PWME: PB12 (P)
 *   PWMC: PB15 (N)     PWMF: PB14 (P)
 *
 * The N outputs on PB11/PB13/PB15 only appear when the driver also sets
 * PWM_SW1/PWM_SW2/PWM_SW3 = 1 (IP_Share bits 15/16/17). The EM32 PWM
 * driver does this automatically when `output-type = <2>` (BOTH) and
 * `use-port-a` is absent or false.
 *
 * The pinctrl nodes (pwma_pb10_p, pwma_pb11_n, pwmb_pb12_p, pwmb_pb13_n,
 * pwmc_pb14_p, pwmc_pb15_n) live in zephyr/dts/arm/elan/em32f967-pinctrl.dtsi
 * and use IOMUX = AF1 for PB10..PB15.
 */

#include <elan/32f967_dv_priv.dtsi>

&pwm0 {
	/*
	 * CRITICAL: the upstream board DTS at
	 * zephyr/boards/elan/32f967_dv/32f967_dv.dts:104 sets `use-port-a;`
	 * because that DTS targets the default PWMB_N-on-PA3 demo. Boolean DT
	 * properties can only be *added* by an overlay, never re-assigned to
	 * false — so we have to explicitly delete it before the driver reads
	 * cfg->use_port_a. Without this, pwm_em32_init() drives PA0-PA5
	 * (PWM_S=0) and the 6 PB pins stay dark.
	 */
	/delete-property/ use-port-a;

	/*
	 * The board DTS also sets pinctrl-0 = <&pwmb_pa3_n>. A scalar
	 * re-assignment from an overlay (the line below) correctly overrides
	 * that. Likewise for output-type.
	 */
	pinctrl-0 = <&pwma_pb10_p &pwma_pb11_n
		     &pwmb_pb12_p &pwmb_pb13_n
		     &pwmc_pb14_p &pwmc_pb15_n>;
	pinctrl-names = "default";

	/*
	 * output-type = 2 (PWM_EM32_OUTPUT_BOTH) — the driver enables both
	 * P and N logic on every channel and sets PWM_SW1/PWM_SW2/PWM_SW3 = 1
	 * so the N outputs route to PB11/PB13/PB15 and the P outputs (which
	 * in this mode carry channels D/E/F) route to PB10/PB12/PB14.
	 */
	output-type = <2>;
};
```

## src/main.c
```c
/*
 * SPDX-FileCopyrightText: 2026 ELAN Microelectronics Corp.
 * SPDX-License-Identifier: Apache-2.0
 */

/**
 * @file
 * @brief EM32F967 All-Port-B PWM Sample
 *
 * Drives all 6 PWM channels (PWMA..PWMF) simultaneously on the Port-B
 * "alternative" pin assignment (PWM_S = 1):
 *
 *   Channel | Pad  | Output
 *   --------+------+-------
 *    PWMA   | PB11 | N
 *    PWMB   | PB13 | N
 *    PWMC   | PB15 | N
 *    PWMD   | PB10 | P
 *    PWME   | PB12 | P
 *    PWMF   | PB14 | P
 *
 * Each channel runs at the same 1 kHz period but with a distinct duty
 * cycle so the six pads can be told apart on a scope. The driver does
 * the register programming (PWM_SW1/2/3 + IP_Share[18] + per-channel
 * PWMAE/IPWMAE/PWMAA/IPWMAA) based on the overlay's `output-type = <2>`
 * and the absence of `use-port-a`.
 */

#include <zephyr/kernel.h>
#include <zephyr/device.h>
#include <zephyr/drivers/pwm.h>
#include <zephyr/logging/log.h>
#include <zephyr/sys/printk.h>

LOG_MODULE_REGISTER(pb_pwm_sample, LOG_LEVEL_INF);

#define PWM_NODE       DT_NODELABEL(pwm0)
#define PWM_PERIOD_NS  1000000U  /* 1 ms = 1 kHz */

struct pwm_ch_info {
	uint32_t channel;   /* 0..5  → PWMA..PWMF */
	const char *name;
	const char *pad;
	const char *role;   /* "P" or "N" */
	uint32_t duty_pct;  /* Fixed duty cycle to make scopes easy */
};

/*
 * Distinct duty cycles so every pad is visibly different on a scope.
 * Order matches the alternative pin assignment requested by the sample.
 */
static const struct pwm_ch_info channels[] = {
	{ 0, "PWMA", "PB11", "N", 10 },
	{ 1, "PWMB", "PB13", "N", 25 },
	{ 2, "PWMC", "PB15", "N", 40 },
	{ 3, "PWMD", "PB10", "P", 55 },
	{ 4, "PWME", "PB12", "P", 70 },
	{ 5, "PWMF", "PB14", "P", 85 },
};

static int arm_channel(const struct device *pwm, const struct pwm_ch_info *ch)
{
	uint32_t pulse_ns = (PWM_PERIOD_NS / 100U) * ch->duty_pct;
	int ret = pwm_set(pwm, ch->channel, PWM_PERIOD_NS, pulse_ns, 0);

	if (ret < 0) {
		printk("  [ch%u %s] pwm_set failed: %d\n", ch->channel, ch->name, ret);
		return ret;
	}

	printk("  [ch%u %s] %s@%s : duty %u%% (pulse=%uns / period=%uns)\n",
	       ch->channel, ch->name, ch->role, ch->pad,
	       ch->duty_pct, pulse_ns, PWM_PERIOD_NS);
	return 0;
}

int main(void)
{
	const struct device *pwm = DEVICE_DT_GET(PWM_NODE);
	int ok = 0;

	printk("\n");
	printk("================================================================\n");
	printk("  EM32F967 All-Port-B PWM Sample (elan_pb_pwm)\n");
	printk("  Build : " __DATE__ " " __TIME__ "\n");
	printk("  Board : 32f967_dv\n");
	printk("  Target: PWMA..PWMF on PB11/PB13/PB15/PB10/PB12/PB14 @ 1 kHz\n");
	printk("================================================================\n");

	if (!device_is_ready(pwm)) {
		printk("[ERR] PWM device %s not ready\n", pwm->name);
		return -ENODEV;
	}
	printk("\n[1/2] PWM device %s ready.\n", pwm->name);

	printk("\n[2/2] Arming all 6 channels at 1 kHz with distinct duty cycles ...\n");
	for (size_t i = 0; i < ARRAY_SIZE(channels); i++) {
		if (arm_channel(pwm, &channels[i]) == 0) {
			ok++;
		}
	}
	printk("      %d / %d channels running\n", ok, (int)ARRAY_SIZE(channels));

	if (ok != ARRAY_SIZE(channels)) {
		printk("[WARN] Not all channels armed — waveform check will be partial.\n");
	}

	printk("\nAll PWM channels are now free-running in hardware.\n");
	printk("Probe PB10..PB15 on the 32f967_dv board to observe 6 simultaneous 1 kHz signals.\n");

	while (1) {
		k_msleep(10000);
		printk("[heartbeat] PWMA..PWMF still driving PB10..PB15 ...\n");
	}

	return 0;
}
```
