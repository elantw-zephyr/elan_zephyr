## Kconfig
```kconfig
rsource "drivers/Kconfig"

# SoC-level additions kept in-module (avoid patching upstream Zephyr Kconfig).
rsource "soc/elan/em32f967/Kconfig.soc"
```

## boards/elan/32f967_dv/32f967_dv_defconfig
```kconfig
# Copyright (c) 2025 ELAN Microelectronics Corp.
#
# SPDX-License-Identifier: Apache-2.0

CONFIG_FLASH=y
CONFIG_FLASH_EM32=y
CONFIG_GPIO=y
CONFIG_SPI=y
CONFIG_SERIAL=y
CONFIG_CONSOLE=y
CONFIG_UART_CONSOLE=y
CONFIG_UART_ELAN_ELANDEV=y
CONFIG_SOC_PREP_HOOK=y
CONFIG_CLOCK_CONTROL=y
CONFIG_CLOCK_CONTROL_EM32_AHB=y
CONFIG_CLOCK_CONTROL_EM32_APB=y
CONFIG_UDC_DRIVER=y
CONFIG_DYNAMIC_INTERRUPTS=y

# Power Management
CONFIG_PM=y
CONFIG_PM_POLICY=y
CONFIG_PM_POLICY_DEFAULT=y

# Logging for debugging
CONFIG_LOG=y
CONFIG_LOG_DEFAULT_LEVEL=2
CONFIG_UDC_DRIVER_LOG_LEVEL=3
```

## drivers/bbram/Kconfig
```kconfig
# SPDX-License-Identifier: Apache-2.0

# Elan EM32 BBRAM driver

config BBRAM_EM32
	bool "Elan EM32 Battery-Backed RAM driver"
	default y
	depends on DT_HAS_ELAN_EM32_BBRAM_ENABLED
	help
	  Enable the EM32 Battery-Backed RAM driver.
	  
	  The EM32 family provides 64 bytes (16 × 32-bit registers) of backup
	  registers that retain data when powered by backup battery (VBAT).
	  
	  This driver manages the backup domain write protection and provides
	  access to 60 bytes of user data (4 bytes reserved for status).
```

## drivers/clock_control/Kconfig
```kconfig
# Clock controller driver configuration options

# SPDX-FileCopyrightText: 2026 ELAN Microelectronics Corp.
#
# SPDX-License-Identifier: Apache-2.0

#
# Clock controller drivers
#

rsource "Kconfig.em32"
```

## drivers/clock_control/Kconfig.elan
```kconfig
# Copyright (c) 2025 Elan Microelectronics Corp.
#
# SPDX-License-Identifier: Apache-2.0

config CLOCK_CONTROL_EM32_AHB
	bool "Elan EM32 AHB clock control"
	default y

config CLOCK_CONTROL_EM32_APB
	bool "Elan EM32 APB clock control"
	default y


config EM32_DELAY_SWITCH_PRIORITY
    int "Delay switch init priority"
    default 1
    help
      Initialization priority for switching the delay backend to k_busy_wait().
      Must be greater than CONFIG_SYSTEM_CLOCK_INIT_PRIORITY, because the
      system timer is initialized in PRE_KERNEL_2.
```

## drivers/crypto/Kconfig
```kconfig
# Copyright (c) 2024 Elan Microelectronics Corp.
# SPDX-License-Identifier: Apache-2.0

config CRYPTO_EM32_SHA
	bool "EM32F967 SHA256 Hardware Acceleration"
	default y
	depends on DT_HAS_ELAN_EM32_CRYPTO_ENABLED
	select CRYPTO
	help
	  Enable hardware SHA256 acceleration for EM32F967 microcontroller.
	  This driver provides SHA-256 hash computation using the dedicated
	  cryptographic hardware engine.

if CRYPTO_EM32_SHA

config CRYPTO_EM32_SHA_INTERRUPT
	bool "Use interrupt-driven operation"
	default n
	help
	  Enable interrupt-driven SHA256 operations instead of polling.
	  This can improve system responsiveness but requires interrupt
	  support to be properly configured.


config CRYPTO_EM32_SHA_PREALLOC_SIZE
	int "Initial accumulation pre-allocation size (bytes)"
	default 8192
	range 512 1048576
	help
	  When the driver switches from the small 256-byte legacy buffer to
	  the accumulation path (single-run hashing), it will ensure the
	  accumulation buffer is at least this large to reduce late
	  reallocations during long messages. Increase if you commonly hash
	  multi-kilobyte messages and have enough heap.

config CRYPTO_EM32_SHA_MAX_ACCUM_SIZE
	int "Maximum accumulation buffer size (bytes)"
	default 65536
	range 4096 1048576
	help
	  Upper bound for the total accumulation buffer size used to collect
	  input prior to the single-run hardware hash. If an input exceeds
	  this size, updates will fail with -ENOMEM. Set based on available
	  RAM and expected message sizes.


config CRYPTO_EM32_SHA_TIMEOUT_USEC
	int "SHA engine completion timeout (usec)"
	default 100000
	range 1000 5000000
	help
	  Maximum time to wait for the SHA engine to signal completion before
	  aborting with a timeout error. Increase if your system clocking is
	  slower or you hash very large inputs.

endif # CRYPTO_EM32_SHA
```

## drivers/entropy/Kconfig
```kconfig
# EM32 TRNG entropy driver Kconfig root
# SPDX-License-Identifier: Apache-2.0

rsource "Kconfig.elan"
```

## drivers/entropy/Kconfig.elan
```kconfig
# EM32F967 TRNG specific Kconfig
# SPDX-License-Identifier: Apache-2.0

config ENTROPY_EM32_TRNG
    bool "Elan EM32F967 TRNG"
    depends on SOC_EM32F967
    default y
    help
      Enable the EM32F967 on-chip True Random Number Generator driver.



config ENTROPY_EM32_TRNG_STARTUP_TIMEOUT_MS
  int "Startup ready timeout (ms)"
  depends on ENTROPY_EM32_TRNG
  default 100
    range 1 1000
    help
      Maximum time to wait for the TRNG to indicate data ready after enabling.



config ENTROPY_EM32_TRNG_INIT_PRIORITY
    int "TRNG init priority (POST_KERNEL level)"
    depends on ENTROPY_EM32_TRNG
    range 0 99
    default 95
    help
      Initialization priority used at POST_KERNEL init level. Set to 95 to ensure clock control and other dependencies are ready. Lower values
      initialize earlier within the level. Increase the number to make TRNG
      initialize later than other POST_KERNEL devices it depends on.
```

## drivers/flash/Kconfig
```kconfig
# Flash controller driver configuration options

# SPDX-FileCopyrightText: 2026 ELAN Microelectronics Corp.
#
# SPDX-License-Identifier: Apache-2.0

#
# Flash controller drivers
#

rsource "Kconfig.em32"
```

## drivers/gpio/Kconfig.em32
```kconfig
# Copyright (c) 2026 ELAN Microelectronics Corp.
# SPDX-License-Identifier: Apache-2.0

# EMC32F967 GPIO driver configuration

config GPIO_EM32
	bool "ELAN EMC32Fxxx GPIO driver"
	default y
	depends on SOC_EM32F967
	depends on DT_HAS_ELAN_EM32_GPIO_ENABLED
	help
	  Enable GPIO driver for ELAN EM32F967 microcontroller.

	  The EM32F967 has two GPIO ports (GPIOA and GPIOB), each with 16 pins.
	  Each port supports:
	  - Input/output direction control
	  - Pull-up/pull-down resistors
	  - Interrupt generation (edge/level triggered)
	  - Alternate function selection

config EM32_WKUP_PINS
	bool "EM32F967 WakeUp controller pin support"
	depends on GPIO_EM32
	depends on PM
	depends on POWEROFF
	help
	  Enable support for the EM32_GPIO_WKUP flag in gpio_pin_configure_dt().

	  When set, the GPIO driver registers the pin with the EM32F967 WakeUp
	  controller (WKUP1-WKUP7). The hardware wakeup path (AF5 IOMUX mux +
	  WAKEUP_REG WAKEUPEN bit + WakeUp_Int_IRQn / IRQ 3) is activated at
	  sys_poweroff() time by em32_pwr_wkup_pin_cfg_pupd(), called from the
	  ELAN poweroff.c implementation.

	  EM32F967 WakeUp pin mapping (hardware-fixed):
	    WKUP1=PA6  WKUP2=PA14  WKUP3=PA15
	    WKUP4=PB3  WKUP5=PB7   WKUP6=PB8   WKUP7=PB9
```

## drivers/hwinfo/Kconfig
```kconfig
# HW Info driver configuration options

# Copyright (c) 2025 Elan Microelectronics Corp.
#
# SPDX-License-Identifier: Apache-2.0

#
# HW Info drivers
#

menuconfig HWINFO
	bool "Hardware Information drivers"
	help
	  Enable hwinfo driver.

if HWINFO

module = HWINFO
module-str = HWINFO
source "subsys/logging/Kconfig.template.log_config"

config HWINFO_HAS_DRIVER
	bool
	help
	  This is an option enabled by individual drivers to signal that there is a hwinfo driver.

rsource "Kconfig.elan"

endif # HWINFO
```

## drivers/hwinfo/Kconfig.elan
```kconfig
# SPDX-FileCopyrightText: 2026 ELAN Microelectronics Corp.
#
# SPDX-License-Identifier: Apache-2.0

config HWINFO_EM32
	bool "Elan EM32 hwinfo"
	default y
	depends on SOC_EM32F967
	select HWINFO_HAS_DRIVER
	help
	  Enable Elan EM32 hwinfo driver.
```

## drivers/pinctrl/Kconfig.em32
```kconfig
# Copyright (c) 2026 Elan Microelectronics
# SPDX-License-Identifier: Apache-2.0

# EM32F967 Pin Control configuration

config PINCTRL_EM32
	bool "EM32F967 pin control driver"
	default y
	depends on DT_HAS_ELAN_EM32_PINCTRL_ENABLED
	help
	  Enable pin control driver for EM32F967 SoC.
	  This driver provides pin multiplexing and configuration
	  support for GPIO, UART, SPI, I2C, and PWM functions.

config PINCTRL_EM32_INIT_PRIORITY
	int "EM32 pinctrl init priority"
	default 45
	depends on PINCTRL_EM32
	help
	  Initialization priority for EM32 pinctrl driver.
```

## drivers/pwm/Kconfig
```kconfig
# SPDX-FileCopyrightText: 2026 ELAN Microelectronics Corp.
# SPDX-License-Identifier: Apache-2.0

# PWM driver configuration options

rsource "Kconfig.em32"
```

## drivers/pwm/Kconfig.em32
```kconfig
# Copyright (c) 2024 ELAN Microelectronics Corp.
# SPDX-License-Identifier: Apache-2.0

config PWM_EM32
	bool "ELAN EM32 PWM driver"
	default y
	depends on DT_HAS_ELAN_EM32_PWM_ENABLED
	select PINCTRL
	help
	  Enable PWM driver for ELAN EM32F967 microcontroller.
	  The EM32F967 has a dedicated 6-channel PWM controller with
	  complementary outputs and programmable dead-time insertion.
```

## drivers/rtc/Kconfig.em32
```kconfig
# Copyright (c) 2024 ELAN Microelectronics Corp.
# SPDX-License-Identifier: Apache-2.0

# EM32 RTC driver configuration

config RTC_EM32
	bool "ELAN EM32 RTC driver"
	default y
	depends on DT_HAS_ELAN_EM32_RTC_ENABLED
	help
	  Enable RTC driver for ELAN EM32 microcontroller family.

	  The EM32 RTC controller supports:
	  - Real-time clock with second, minute, hour, day counters
	  - Alarm functionality with configurable time
	  - Interrupt generation on alarm match
	  - Low power operation with external 32.768kHz crystal
	  - Calendar functionality
```

## drivers/serial/Kconfig.elan
```kconfig
# Copyright (c) 2025 Elan Microelectronics Corp..
# SPDX-License-Identifier: Apache-2.0

config UART_ELAN_ELANDEV
	bool "ELAN 967 serial driver"
	default y
	depends on DT_HAS_ELAN_ELANDEV_UART_ENABLED
	select SERIAL_HAS_DRIVER
	help
	  This option enables the elan 967 serial driver.
```

## drivers/serial/Kconfig.em32
```kconfig
# SPDX-FileCopyrightText: 2026 ELAN Microelectronics Corp.
# SPDX-License-Identifier: Apache-2.0

config UART_EM32
	bool "ELAN EM32 serial driver"
	default y
	depends on SOC_EM32F967
	depends on DT_HAS_ELAN_EM32_UART_ENABLED
	select SERIAL_HAS_DRIVER
	select PINCTRL
	help
	  This option enables the elan em32 serial driver.

config UART_EM32_INIT_PRIORITY
	int "EM32 UART initialization priority"
	default 65
	depends on UART_EM32
	help
	  Initialization priority for the EM32 UART driver.
	  This must be greater than CLOCK_CONTROL_EM32_APB_INIT_PRIORITY since
	  UART depends on the clock driver and pinctrl.
```

## drivers/spi/Kconfig.elan
```kconfig
config SPI_ELAN_ELANDEV
	bool "Elan e967 SPI driver"
	default y

if SPI_ELAN_ELANDEV
config SPI_ELAN_ELANDEV_INTERRUPT
	bool "Elan e967 SPI Interrupt Support"
	default n
	help
	  Enable Interrupt support for SPI communication.

endif
```

## drivers/timer/Kconfig.em32
```kconfig
# Copyright (c) 2024 ELAN Microelectronics Corp.
# SPDX-License-Identifier: Apache-2.0

# EM32 Timer driver configuration

config TIMER_EM32
	bool "ELAN EM32 Timer driver"
	default y
	depends on DT_HAS_ELAN_EM32_TIMER_ENABLED
	help
	  Enable Timer driver for ELAN EM32 microcontroller family.

	  The EM32 Timer controller supports:
	  - 32-bit down counter with auto-reload
	  - Configurable prescaler (1, 16, 256)
	  - One-shot and periodic modes
	  - Interrupt generation on underflow
	  - System timer functionality
```
