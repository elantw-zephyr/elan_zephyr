## drivers/watchdog/Kconfig.em32
```kconfig
# Copyright (c) 2024 ELAN Microelectronics Corp.
# SPDX-License-Identifier: Apache-2.0

# EM32 Watchdog driver configuration

config WDT_EM32
	bool "ELAN EM32 Watchdog driver"
	default y
	depends on DT_HAS_ELAN_EM32_WDT_ENABLED
	help
	  Enable Watchdog driver for ELAN EM32 family microcontrollers.
	  
	  The EM32 Watchdog controller supports:
	  - 32-bit down counter with configurable timeout
	  - Reset generation on timeout
	  - Interrupt generation before reset (optional)
	  - Lock mechanism to prevent accidental configuration changes
	  - Feed operation to reset the counter
```

## dts/bindings/bbram/elan,em32-bbram.yaml
```yaml
description: |
  Elan EM32 Battery-Backed RAM (BBRAM) driver

  The EM32 family provides 64 bytes (16 × 32-bit registers) of backup registers
  that retain data when powered by backup battery (VBAT).
  
  Note: This driver uses hardware-specific clock gating (BKP clock bit 24)
  rather than the generic clock control framework.

  Example:
    bbram0: bbram@40033000 {
        compatible = "elan,em32-bbram";
        reg = <0x40033000 0x40>;
        backup-regs-count = <16>;
        status = "okay";
    };

compatible: "elan,em32-bbram"

include: [base.yaml]

properties:
  reg:
    required: true
    description: |
      Register space for backup registers
      
  backup-regs-count:
    type: int
    required: true
    description: |
      Number of 32-bit backup registers available
      
  clocks:
    required: false
    description: |
      Optional clock control (driver uses hardware-specific BKP clock gate)
      Clock source for backup domain access
```

## dts/bindings/clock/elan,em32-ahb-v2.yaml
```yaml
# Copyright (c) 2026 Elan Microelectronics Corp.
# SPDX-License-Identifier: Apache-2.0

description: Elan eM32F967 AHB Clock Controller Node (v2, gate specifier)

compatible: "elan,em32-ahb-v2"

include: [base.yaml, clock-controller.yaml]

properties:
  clock-source:
    type: int
    description: ID of output clock source
    required: true

  clock-frequency:
    type: int
    description: ID of output clock frequency
    required: true

  clock-divider:
    type: int
    description: ID of output clock divider
    required: true

  "#clock-cells":
    const: 1

clock-cells:
  - gate
```

## dts/bindings/clock/elan,em32-apb-v2.yaml
```yaml
# Copyright (c) 2026 Elan Microelectronics Corp.
# SPDX-License-Identifier: Apache-2.0

description: Elan eM32F967 APB Clock Controller Node (v2, gate specifier)

compatible: "elan,em32-apb-v2"

include: [base.yaml, clock-controller.yaml]

properties:
  clocks:
    type: phandle-array
    description: Clock reference source
    required: true

  "#clock-cells":
    const: 1

clock-cells:
  - gate
```

## dts/bindings/crypto/elan,em32-crypto.yaml
```yaml
# SPDX-FileCopyrightText: 2026 ELAN Microelectronics Corp.
# SPDX-License-Identifier: Apache-2.0

description: EM32F967 Cryptographic Hardware Acceleration

compatible: "elan,em32-crypto"

include: [base.yaml, pinctrl-device.yaml]

properties:
  reg:
    required: true

  clocks:
    required: true

  interrupts:
    required: false

  pinctrl-0:
    required: false

  pinctrl-names:
    required: false
```

## dts/bindings/dma/elan,em32f967-dma.yaml
```yaml
# Copyright (c) 2024 ELAN Microelectronics Corp.
# SPDX-License-Identifier: Apache-2.0

description: ELAN EM32F967 DMA controller

compatible: "elan,em32f967-dma"

include: dma-controller.yaml

properties:
  reg:
    required: true

  interrupts:
    required: true

  clocks:
    required: true

  "#dma-cells":
    const: 1

  dma-channels:
    type: int
    required: true
    description: Number of DMA channels supported by the controller

dma-cells:
  - channel
```

## dts/bindings/entropy/elan,em32-trng.yaml
```yaml
# SPDX-License-Identifier: Apache-2.0
# Devicetree binding for EM32F967 TRNG

description: EM32F967 True Random Number Generator providing hardware entropy source

compatible: "elan,em32-trng"

include: base.yaml

properties:
  reg:
    description: TRNG register base address and size
    required: true
  clocks:
    description: Optional APB clock provider
  interrupts:
    description: Optional interrupt spec (IRQ and priority)
  sample-rate:
    type: int
    description: Raw entropy sampling divider (hardware dependent / TBD)
  health-test-disable:
    type: boolean
    description: Disable runtime health tests (diagnostics only; reduces security)
```

## dts/bindings/flash_controller/elan,em32-flash-controller.yaml
```yaml
# Copyright (c) 2025 Elan Microelectronics Corp..
# SPDX-License-Identifier: Apache-2.0

#TODO add what is needed

description: ELAN 967 FLASH

compatible: "elan,em32-flash-controller"

include: flash-controller.yaml
```

## dts/bindings/hwinfo/elan,em32-uid.yaml
```yaml
# Copyright (c) 2025 Elan Microelectronics Corp.
# SPDX-License-Identifier: Apache-2.0

description: Elan eM32F967 32-bit Unique Identifier

compatible: "elan,em32-uid"

include: base.yaml

properties:
  reg:
    required: true
```

## dts/bindings/rtc/elan,em32-rtc.yaml
```yaml
# Copyright (c) 2024 ELAN Microelectronics Corp.
# SPDX-License-Identifier: Apache-2.0

description: EM32 Real-Time Clock

compatible: "elan,em32-rtc"

include:
  - name: base.yaml

properties:
  reg:
    required: true

  clocks:
    required: true

  interrupts:
    required: false

  clock-frequency:
    type: int
    default: 32768
    description: |
      RTC clock frequency in Hz. Typically 32768 Hz for external crystal.

  label:
    required: false
```

## dts/bindings/rtc/elan,em32f902-rtc.yaml
```yaml
# Copyright (c) 2024 ELAN Microelectronics Corp.
# SPDX-License-Identifier: Apache-2.0

description: EM32F902 Real-Time Clock

compatible: "elan,em32f902-rtc"

include:
  - name: base.yaml

properties:
  reg:
    required: true

  clocks:
    required: true

  interrupts:
    required: false

  clock-frequency:
    type: int
    default: 32768
    description: |
      RTC clock frequency in Hz. Typically 32768 Hz for external crystal.

  label:
    required: false
```

## dts/bindings/serial/elan,elandev-uart.yaml
```yaml
# Copyright (c) 2025 Elan Microelectronics Corp..
# SPDX-License-Identifier: Apache-2.0

description: ELAN 967 UART

compatible: "elan,elandev-uart"

include:
  - name: uart-controller.yaml
  - name: pinctrl-device.yaml
  - name: reset-device.yaml
  - name: uart-controller-pin-inversion.yaml

properties:
  clocks:
    type: phandle-array
    description: Input clock source for UART peripheral.
    required: true
  reg:
    required: true
  current-speed:
    required: true

  pinctrl-0:
    required: true

  pinctrl-names:
    required: true
```

## dts/bindings/spi/elan,elandev-spi2.yaml
```yaml
description: ELAN e967 SPI controller

compatible: "elan,elandev-spi2"

include:
  - spi-controller.yaml
  - pinctrl-device.yaml

properties:
  reg:
    required: true
  clocks:
    type: phandle-array
    description: Source of SPI clock.
    required: true
```

## dts/bindings/timer/elan,em32-timer.yaml
```yaml
# Copyright (c) 2024 ELAN Microelectronics Corp.
# SPDX-License-Identifier: Apache-2.0

description: EM32 Timer Controller

compatible: "elan,em32-timer"

include:
  - name: base.yaml

properties:
  reg:
    required: true

  clocks:
    required: true

  interrupts:
    required: true

  prescaler:
    type: int
    default: 1
    description: |
      Timer prescaler value. Valid values are 1, 16, or 256.
      This divides the input clock frequency.

  label:
    required: false
```

## dts/bindings/usb/elan,elandev-usbd.yaml
```yaml
# Copyright (c) 2022 Nuvoton Technology Corporation
# SPDX-License-Identifier: Apache-2.0

description: ELAN E967 USB device controller

compatible: "elan,elandev-usbd"

include: [usb-ep.yaml]

properties:
  reg:
    required: true
```

## dts/bindings/watchdog/elan,em32-wdt.yaml
```yaml
# Copyright (c) 2024 ELAN Microelectronics Corp.
# SPDX-License-Identifier: Apache-2.0

description: EM32 Watchdog Timer

compatible: "elan,em32-wdt"

include:
  - name: base.yaml

properties:
  reg:
    required: true

  clocks:
    required: true

  interrupts:
    required: false

  timeout-sec:
    type: int
    default: 30
    description: |
      Default watchdog timeout in seconds.
      The actual timeout depends on the clock frequency and prescaler.

  label:
    required: false
```

## dts/bindings/watchdog/elan,em32f902-wdt.yaml
```yaml
# Copyright (c) 2024 ELAN Microelectronics Corp.
# SPDX-License-Identifier: Apache-2.0

description: EM32F902 Watchdog Timer

compatible: "elan,em32f902-wdt"

include:
  - name: base.yaml

properties:
  reg:
    required: true

  clocks:
    required: true

  interrupts:
    required: false

  timeout-sec:
    type: int
    default: 30
    description: |
      Default watchdog timeout in seconds.
      The actual timeout depends on the clock frequency and prescaler.

  label:
    required: false
```

## soc/elan/em32f967/Kconfig.soc
```kconfig
# SPDX-FileCopyrightText: 2026 ELAN Microelectronics Corp.
# SPDX-License-Identifier: Apache-2.0

# Module-side SoC Kconfig additions for EM32F967.
#
# Keep upstream SoC description minimal and move module-specific selects here.

if SOC_EM32F967

config ELAN_EM32F967_HAS_PM
	bool
	default y
	select HAS_PM
	select HAS_POWEROFF
	help
	  Internal helper symbol.
	  Select HAS_PM and HAS_POWEROFF when building for ELAN EM32F967 using the elan_zephyr module.
	  HAS_POWEROFF allows CONFIG_POWEROFF=y (sys_poweroff() API), implemented by poweroff.c.

endif # SOC_EM32F967

config SOC_EM32F967_PM
    bool "EM32F967 Power Management Support"
    default y
    help
      Enable power management functions for ultra-low power modes
      (140 μA deep sleep target). Requires clock gating and
      power domain switching hardware.

config SOC_EM32F967_PM_DEEP_SLEEP
    bool "Enable Deep Sleep Mode (140 μA)"
    depends on SOC_EM32F967_PM
    default y
    help
      Enables em32f967_set_deep_sleep_config() and related functions.
      Achieves 140 μA standby power with USB/GPIO wake-up capability.

config SOC_EM32F967_PM_EXTERNAL_WAKEUP
    bool "Enable External GPIO Wake-Up (PA15)"
    depends on SOC_EM32F967_PM
    default y
    help
      Configures PA15 for falling-edge detection to wake from
      deep sleep. Required for interactive fingerprint mode.

config SOC_EM32F967_PM_USB_WAKEUP
    bool "Enable USB Remote Wake-Up"
    depends on SOC_EM32F967_PM
    default y
    help
      Enables USB PHY to detect host resume signaling and wake
      the MCU from deep sleep.

config SOC_EM32F967_PM_STANDBY1
    bool "Enable Standby1 Mode (PDSW2)"
    depends on SOC_EM32F967_PM
    default y
    help
      Enables em32f967_enter_standby1() for persistent resume state.
      Provides ~180KB of retained RAM for application state.
```
