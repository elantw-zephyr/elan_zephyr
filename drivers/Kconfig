## drivers/Kconfig
```kconfig
rsource "flash/Kconfig"
rsource "spi/Kconfig"
rsource "usb/Kconfig"
rsource "hwinfo/Kconfig"
rsource "bbram/Kconfig"
rsource "entropy/Kconfig"
rsource "watchdog/Kconfig"
rsource "crypto/Kconfig"
rsource "rtc/Kconfig"
rsource "timer/Kconfig"
rsource "pwm/Kconfig"
```

## drivers/flash/Kconfig.em32
```kconfig
# SPDX-FileCopyrightText: 2026 ELAN Microelectronics Corp.
#
# SPDX-License-Identifier: Apache-2.0

config FLASH_EM32
	bool "ELAN eM32 flash controller driver"
	default y
	depends on DT_HAS_ELAN_EM32_FLASH_CONTROLLER_ENABLED
	select FLASH_HAS_DRIVER_ENABLED
	select MPU_ALLOW_FLASH_WRITE if ARM_MPU
	help
	  This option enables Elan eM32 flash driver.
```
